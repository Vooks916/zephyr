/*
 * Copyright (c) 2025 Microchip Technology Inc.
 *
 * SPDX-License-Identifier: Apache-2.0
 */

/ {
	zephyr,user {
		/* PA02, DAC VOUT0 */
		dac = <&dac>;
		dac-channel-id = <0>;
		dac-resolution = <12>;
	};
};
