/*
 * SPDX-License-Identifier: Apache-2.0
 */

/ {
	zephyr,user {
		/* PA04, ADC AIN[4] */
		io-channels = <&adc 4>;
	};
};

&adc {
	#address-cells = <1>;
	#size-cells = <0>;

	channel@4 {
		reg = <4>;
		zephyr,gain = "ADC_GAIN_1";
		zephyr,reference = "ADC_REF_INTERNAL";
		zephyr,acquisition-time = <ADC_ACQ_TIME_DEFAULT>;
		zephyr,resolution = <12>;
		zephyr,input-positive = <4>;
	};
};
