/*
 * Copyright The Zephyr Project Contributors
 *
 * SPDX-License-Identifier: Apache-2.0
 */

#include <atmel/samd21.dtsi>
#include <atmel/samx2xx17.dtsi>

/ {
	aliases {
		tcc-3 = &tcc3;
	};

	soc {
		tcc3: tcc@42006000 {
			compatible = "atmel,sam0-tcc";
			reg = <0x42006000 0x80>;
			interrupts = <29 0>;
			clocks = <&gclk 0x25>, <&pm 0x20 24>;
			clock-names = "GCLK", "PM";
			atmel,assigned-clocks = <&gclk 0>;
			atmel,assigned-clock-names = "GCLK";
			status = "disabled";

			channels = <4>;
			counter-size = <24>;
		};
	};
};
