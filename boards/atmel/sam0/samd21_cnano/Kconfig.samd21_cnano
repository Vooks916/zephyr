## boards/atmel/sam0/samd21_cnano/Kconfig.samd21_cnano
```kconfig
# SPDX-License-Identifier: Apache-2.0

config BOARD_SAMD21_CNANO
	select SOC_SAMD21G17D
```

## boards/atmel/sam0/samd21_cnano/board.yml
```yaml
board:
  name: samd21_cnano
  full_name: SAM D21 Curiosity Nano Evaluation Kit
  vendor: atmel
  socs:
    - name: samd21g17d
```

## boards/atmel/sam0/samd21_cnano/samd21_cnano_defconfig
```kconfig
# SPDX-License-Identifier: Apache-2.0

CONFIG_SOC_ATMEL_SAMD_OSC8M=y
CONFIG_SOC_ATMEL_SAMD_OSC8M_AS_MAIN=y

CONFIG_BUILD_OUTPUT_HEX=y
```

## boards/atmel/sam0/same51_cnano/board.yml
```yaml
board:
  name: same51_cnano
  full_name: SAM E51 Curiosity Nano Evaluation Kit
  vendor: atmel
  socs:
    - name: same51j20a
```

## boards/microchip/sam/samd21_cnano/board.yml
```yaml
board:
  name: samd21_cnano
  full_name: SAM D21 Curiosity Nano
  vendor: microchip
  socs:
    - name: samd21g17d
```

## boards/microchip/sam/same51_cnano/Kconfig.same51_cnano
```kconfig
# Copyright (c) 2025 Microchip Technology Inc.
# SPDX-License-Identifier: Apache-2.0

config BOARD_SAME51_CNANO
	select SOC_ATSAME51J20A
```

## boards/microchip/sam/same51_cnano/board.yml
```yaml
board:
  name: same51_cnano
  full_name: SAM E51 Curiosity Nano Evaluation Kit
  vendor: microchip
  socs:
    - name: same51j20a
```
